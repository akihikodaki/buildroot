## package/python-pyqt5/Config.in
```kconfig
comment "python-pyqt5 needs a toolchain w/ C++, threads"
	depends on BR2_USE_MMU
	depends on !BR2_INSTALL_LIBSTDCPP || !BR2_TOOLCHAIN_HAS_THREADS

config BR2_PACKAGE_PYTHON_PYQT5
	bool "python-pyqt5"
	depends on BR2_INSTALL_LIBSTDCPP
	depends on BR2_TOOLCHAIN_HAS_THREADS # qt
	depends on BR2_USE_MMU # qt
	select BR2_PACKAGE_QT5
	select BR2_PACKAGE_PYTHON_SIP
	help
	  PyQt5 for Qt Embedded 5 bindings.

	  http://www.riverbankcomputing.com/software/pyqt/
```

## package/qt5/qt5webengine/Config.in
```kconfig
config BR2_PACKAGE_QT5WEBENGINE
	bool "qt5webengine"
	depends on !BR2_ARM_CPU_ARMV4 && !BR2_ARM_CPU_ARMV5
	select BR2_PACKAGE_QT5BASE
	select BR2_PACKAGE_QT5BASE_GUI
	select BR2_PACKAGE_QT5BASE_FONTCONFIG
	select BR2_PACKAGE_QT5BASE_DBUS
	select BR2_PACKAGE_QT5BASE_ICU
	select BR2_PACKAGE_QT5DECLARATIVE
	select BR2_PACKAGE_QT5WEBCHANNEL
	select BR2_PACKAGE_FFMPEG
	select BR2_PACKAGE_OPUS
	select BR2_PACKAGE_LIBVPX
	select BR2_PACKAGE_WEBP_DEMUX
	select BR2_PACKAGE_OPENSSL
	select BR2_PACKAGE_LIBCAP
	select BR2_PACKAGE_LIBGLIB2
	select BR2_PACKAGE_XLIB_LIBXCOMPOSITE if BR2_PACKAGE_QT5BASE_XCB
	select BR2_PACKAGE_XLIB_LIBXCURSOR if BR2_PACKAGE_QT5BASE_XCB
	select BR2_PACKAGE_XLIB_LIBXI if BR2_PACKAGE_QT5BASE_XCB
	select BR2_PACKAGE_XLIB_LIBXRANDR if BR2_PACKAGE_QT5BASE_XCB
	select BR2_PACKAGE_XLIB_LIBXSCRNSAVER if BR2_PACKAGE_QT5BASE_XCB
	select BR2_PACKAGE_XLIB_LIBXTST if BR2_PACKAGE_QT5BASE_XCB
	help
	  Qt is a cross-platform application and UI framework for
	  developers using C++.

	  This package corresponds to the qt5webengine module.

	  http://qt.io
```
